## app/dts/bindings/zmk,input-listener.yaml
```yaml
description: |
  Listener to subscribe to input events and send HID updates after processing

compatible: "zmk,input-listener"

properties:
  mode:
    type: string
    default: "mouse"
    enum:
      - "mouse"
      - "trackpad"
  device:
    type: phandle
    required: true
  xy-swap:
    type: boolean
  x-invert:
    type: boolean
  y-invert:
    type: boolean
  scale-multiplier:
    type: int
    default: 1
  scale-divisor:
    type: int
    default: 1
```

## app/src/mouse/Kconfig
```kconfig
# Copyright (c) 2023 The ZMK Contributors
# SPDX-License-Identifier: MIT

menuconfig ZMK_MOUSE
    bool "Mouse Emulation"
    select INPUT
    select INPUT_THREAD_PRIORITY_OVERRIDE
    select USB_COMPOSITE_DEVICE if ZMK_USB

if ZMK_MOUSE

if ZMK_USB

config USB_HID_DEVICE_COUNT
    default 2

endif

config ZMK_TRACKPAD
    bool "Trackpad support"
    select ENABLE_HID_INT_OUT_EP if ZMK_USB

if ZMK_TRACKPAD

if ZMK_USB

config USB_REQUEST_BUFFER_SIZE
    default 512

config HID_INTERRUPT_EP_MPS
    default 64

endif

config ZMK_TRACKPAD_FINGERS
    int "Max simultaneous fingers"
    default 5

config ZMK_TRACKPAD_LOGICAL_X
    int "Logical X"

config ZMK_TRACKPAD_LOGICAL_Y
    int "Logical Y"

config ZMK_TRACKPAD_PHYSICAL_X
    int "Physical X"

config ZMK_TRACKPAD_PHYSICAL_Y
    int "Physical Y"

endif # ZMK_TRACKPAD

endif # ZMK_MOUSE
```

## app/src/studio/Kconfig
```kconfig
# Copyright (c) 2024 The ZMK Contributors
# SPDX-License-Identifier: MIT

menuconfig ZMK_STUDIO
    bool "Studio Support"
    select NANOPB
    # These two save stack size
    imply NANOPB_NO_ERRMSG
    imply  NANOPB_WITHOUT_64BIT
    select ZMK_BEHAVIOR_METADATA
    help
      Add firmware support for realtime keymap updates (ZMK Studio

if ZMK_STUDIO

menu "Remote Procedure Calls (RPC)"

menu "Transports"

config ZMK_STUDIO_TRANSPORT_UART
    bool "Serial"
    select SERIAL
    select RING_BUFFER
    default y if ZMK_USB

config ZMK_STUDIO_TRANSPORT_BLE
    bool "BLE (GATT)"
    select RING_BUFFER
    select BT_USER_DATA_LEN_UPDATE
    depends on ZMK_BLE
    default y

config BT_CONN_TX_MAX
    default 64 if ZMK_STUDIO_TRANSPORT_BLE

endmenu

config ZMK_STUDIO_RPC_THREAD_STACK_SIZE
    int "RPC Thread Stack Size"
    default 1800

config ZMK_STUDIO_RPC_RX_BUF_SIZE
    int "RX Buffer Size"
    default 30

config ZMK_STUDIO_RPC_TX_BUF_SIZE
    int "RX Buffer Size"
    default 64

endmenu

endif
```

## app/west.yml
```yaml
manifest:
  remotes:
    - name: zephyrproject-rtos
      url-base: https://github.com/zephyrproject-rtos
    - name: zmkfirmware
      url-base: https://github.com/zmkfirmware
    - name: petejohanson
      url-base: https://github.com/petejohanson
  projects:
    - name: zephyr
      remote: petejohanson
      revision: v3.5.0+zmk-use-zmk-nanopb-fork-with-stack-size-reduction
      clone-depth: 1
      import:
        name-blocklist:
          - ci-tools
          - hal_altera
          - hal_cypress
          - hal_infineon
          - hal_microchip
          - hal_nxp
          - hal_openisa
          - hal_silabs
          - hal_xtensa
          - hal_st
          - hal_ti
          - loramac-node
          - mcuboot
          - mcumgr
          - net-tools
          - openthread
          - edtt
          - trusted-firmware-m
    - name: nanopb
      revision: bf328175df765d05cbc0c19734af85378af0280c
      path: modules/lib/nanopb
      remote: zmkfirmware
    - name: zmk-studio-messages
      revision: a79267a9661241a6603b6da3d2b3f71e8023a9d9
      path: modules/msgs/zmk-studio-messages
      remote: zmkfirmware
  self:
    west-commands: scripts/west-commands.yml
```
